## sdkconfig.defaults
```kconfig
# ESP32 Audio Delay Project Configuration

# ESP32 Configuration
CONFIG_ESP32_DEFAULT_CPU_FREQ_240=y
CONFIG_ESP32_DEFAULT_CPU_FREQ_MHZ=240

# FreeRTOS Configuration
CONFIG_FREERTOS_HZ=1000
CONFIG_FREERTOS_UNICORE=n

# Memory Configuration
CONFIG_ESP32_SPIRAM_SUPPORT=y
CONFIG_SPIRAM_USE_MALLOC=y
CONFIG_SPIRAM_MALLOC_ALWAYSINTERNAL=16384

# I2C Configuration
CONFIG_I2C_ENABLE_DEBUG_LOG=n

# Audio Configuration
CONFIG_ESP32_I2S_ENABLE_DEBUG_LOG=n

# NVS Configuration
CONFIG_NVS_ENCRYPTION=n

# Log Configuration
CONFIG_LOG_DEFAULT_LEVEL_INFO=y
CONFIG_LOG_DEFAULT_LEVEL=3
```
